;
; Main_serial.asm
;
; Created: 17/04/2025 7:13:03 p. m.
; Author : JOSE
;

; Replace with your application code
;PINES USADOS: PORTC,0

.INCLUDE		"M16ADEF.INC"
.CSEG
.ORG			0			JMP		INICIO
.ORG			$00C		JMP		TX

INICIO:
    LDI			R16,HIGH(RAMEND)
	OUT			SPH,R16
	LDI			R16,LOW(RAMEND)
	OUT			SPL,R16
	LDI			R16,0B00000000		;PINES DEL PUERTO A COMO ENTRADAS
	OUT			DDRA,R16
	LDI			R16,0B11110011		;RB2,RB3 COMO ENTRADA. EL RESTO COMO SALIDA
	OUT			DDRB,R16
	LDI			R16,0B11111111		;PINES DEL PUERTO C COMO SALIDAS
	OUT			DDRC,R16
	LDI			R16,0B11111110		;RD0 COMO ENTRADA, RD1:RD7 COMO SALIDAS
	OUT			DDRD,R16
	CLR			R17
	CLR			R18
	CLR			R19	
	CALL		USART
	CALL		VACIADO	
	CALL		TEMPORIZADOR
	SEI

ESPERA:
	JMP			ESPERA

;F U N C I O N E S

;VACIADO DE UDR
VACIADO:
	SBIS		UCSRA,5
	JMP			VACIADO
	RET

;CONFIGURACION DEL MODULO USART
USART:
	LDI			R16,0B00000000
	OUT			UBRRH,R16			
	;LDI			R16,0B00000110	;9600 BAUDIOS
	;LDI			R16,0B00000000	;57600 BAUDIOS
	LDI			R16,0B00011001	;2400 BAUDIOS
	OUT			UBRRL,R16			
	LDI			R16,0B00000000
	OUT			UCSRA,R16
	LDI			R16,0B10000110
	OUT			UCSRC,R16
	LDI			R16,0B00001000		;HABILITO TRANSMISION
	OUT			UCSRB,R16
	RET

;RETRASO DE TRANSMISION ENTRE BYTES
RETRASO:
	;LDI			R19,SREG			;AGREGADO
	LDI			R16,0B00001101		;PRESCALER DE 1024
	OUT			TCCR0,R16
	;LDI			R16,0B00000000
	;OUT			TIMSK,R16
	LDI			R16,0B11111111		;TIEMPO DE RETRASO
	OUT			OCR0,R16

ESPERACOMP:
	IN			R18,TIFR
	SBRS		R18,1
	JMP			ESPERACOMP
	;LDI			R16,0B00000010
	OUT			TIFR,R16
	LDI			R16,0B00000000
	OUT			TCCR0,R16
	OUT			TIFR,R16
	OUT			OCR0,R16
	OUT			TCNT0,R16
	LDI			R18,0B00000000
	NOP
	RET

TEMPORIZADOR:
	LDI			R16,0B00010000
	OUT			TIMSK,R16	
	LDI			R16,0B11111111
	OUT			OCR1AH,R16
	LDI			R16,0B11111111
	OUT			OCR1AL,R16
	LDI			R16,0B00000000
	OUT			TCCR1A,R16
	LDI			R16,0B00001101
	OUT			TCCR1B,R16
	RET	

TX:
	LDI			R17,SREG
	CLI
	SBI			PORTC,1
	INC			R19

PRESCALER:
	SBRS		R19,2					;Prescaler normal en main.
	JMP			FIN

TX_DATO_10:	
	SBI			PORTC,0					;INICIO TX
	LDI			R16,0X31				;CARGA DEL DATO A ENVIAR
	OUT			UDR,R16
	CALL		VACIADO
	
	TX_DATO_11:
		SBIS		UCSRA,6
		JMP			TX_DATO_11
		SBI			UCSRA,6	
		LDI			R16,0X01		;CARGA DEL DATO A ENVIAR
		OUT			UDR,R16
		CALL		VACIADO

		TX_DATO_12:
			SBIS		UCSRA,6
			JMP			TX_DATO_12
			SBI			UCSRA,6	
			LDI			R16,0X06		;CARGA DEL DATO A ENVIAR
			OUT			UDR,R16
			CALL		VACIADO

			TX_DATO_13:
				SBIS		UCSRA,6
				JMP			TX_DATO_13
				SBI			UCSRA,6	
				LDI			R16,0X6C		;CARGA DEL DATO A ENVIAR
				OUT			UDR,R16
				CALL		VACIADO
				CALL		RETRASO
				CALL		RETRASO			;RETRASO AGREGADO 30042025
				CALL		RETRASO			;RETRASO AGREGADO 30042025
				CALL		RETRASO			;RETRASO AGREGADO 30042025
				CALL		RETRASO			;RETRASO AGREGADO 30042025				

TX_DATO_20:
	LDI			R16,0X31			;CARGA DEL DATO A ENVIAR
	OUT			UDR,R16
	CALL		VACIADO
	
	TX_DATO_21:
		SBIS		UCSRA,6
		JMP			TX_DATO_21
		SBI			UCSRA,6	
		LDI			R16,0X02		;CARGA DEL DATO A ENVIAR
		OUT			UDR,R16
		CALL		VACIADO

		TX_DATO_22:
			SBIS		UCSRA,6
			JMP			TX_DATO_22
			SBI			UCSRA,6	
			LDI			R16,0X06		;CARGA DEL DATO A ENVIAR
			OUT			UDR,R16
			CALL		VACIADO

			TX_DATO_23:
				SBIS		UCSRA,6
				JMP			TX_DATO_23
				SBI			UCSRA,6	
				LDI			R16,0X39		;CARGA DEL DATO A ENVIAR
				OUT			UDR,R16
				CALL		VACIADO
				CLR			R19
				CALL		RETRASO			;RETRASO AGREGADO 30042025
				CALL		RETRASO			;RETRASO AGREGADO 30042025
				CALL		RETRASO			;RETRASO AGREGADO 30042025
				CALL		RETRASO			;RETRASO AGREGADO 30042025		
FIN:
	CBI			PORTC,0
	CALL		RETRASO
	LDI			R16,0B00010000
	OUT			TIMSK,R16
	OUT			SREG,R17
	SEI
	RETI
